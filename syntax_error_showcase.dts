// This file showcases the many recoverable syntax errors dt-parser supports
/dts-v1/;

#include
#define

/ {
  a = <2>
  ascii-unexpected` = <0>;
  b = <2 (3))>;
  c "AA";
  d = ;
  e = <;
  f = <0 4 5;
  = <1 2 3>;
  h = <1, 2>, <3,4>;
  i = <1> <2>;
  j = <&LABEL, &{ /path } & LABEL>; // TODO: warn for `&LABEL,`
  k a b k = <1>;
  l = <0b1 , 0o2  , 0x3 ,>;
  m = <1 "unexpected" 1>;

  // forgot node's name
  {
    foo = <1>;
  };
  utf-8ä = <0>;
};

foo {
  a = <1>;

